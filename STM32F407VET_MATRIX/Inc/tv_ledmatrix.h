#ifndef __tv_ledmatrix
#define __tv_ledmatrix
#include "main.h"
#include "font32x32.h"
#include "font.h"
#include<stdio.h>
#include<stdlib.h>
#include<stdio.h>
#include<stdlib.h>
#include<math.h>

#define setbit(sfr,bit)		(sfr|=(1<<bit))
#define clrbit(sfr,bit)		(sfr&=~(1<<bit))


unsigned char manght[3][128][128]; 
unsigned char  mangxuatled[16][8][256];//8 hien thi mau sac
unsigned char  mangxuatled1[16][8][256];

const unsigned short mangtg[]={40,80,160,320,640,1280,2560,5120};
char check_bit(unsigned char byte,unsigned char bit){
	if((byte&(1<<bit))==0x00){
		return 0;
	}
	else{
		return 1;
	}
}
void giaima(){
	signed short hang,ktbit,cot,pixel,pwm;
	for(hang=0;hang<16;hang++){
		 for(pwm=0,pixel=0x01;pwm<8;pixel<<=1,pwm++){
			 for(cot=0;cot<256;cot++){
				 if(cot<128){
					 mangxuatled[hang][pwm][cot]=0;
					 if((manght[0][hang][cot] & pixel)) {mangxuatled[hang][pwm][cot] |= 0x01;}
					 if((manght[0][hang+16][cot] & pixel)) {mangxuatled[hang][pwm][cot] |= 0x02;}
					 if((manght[1][hang][cot] & pixel)) {mangxuatled[hang][pwm][cot] |= 0x04;}
					 if((manght[1][hang+16][cot] & pixel)) {mangxuatled[hang][pwm][cot] |= 0x08;}
					 if((manght[2][hang][cot] & pixel)) {mangxuatled[hang][pwm][cot] |= 0x10;}
					 if((manght[2][hang+16][cot] & pixel)) {mangxuatled[hang][pwm][cot] |= 0x20;}
				 }
				 else{
					 mangxuatled[hang][pwm][cot]=0;
					 if((manght[0][63-hang][128-cot] & pixel)) {mangxuatled[hang][pwm][cot] |= 0x01;}
					 if((manght[0][47-hang][128-cot] & pixel)) {mangxuatled[hang][pwm][cot] |= 0x02;}
					 if((manght[1][63-hang][128-cot] & pixel)) {mangxuatled[hang][pwm][cot] |= 0x04;}
					 if((manght[1][47-hang][128-cot] & pixel)) {mangxuatled[hang][pwm][cot] |= 0x08;}
					 if((manght[2][63-hang][128-cot] & pixel)) {mangxuatled[hang][pwm][cot] |= 0x10;}
					 if((manght[2][47-hang][128-cot] & pixel)) {mangxuatled[hang][pwm][cot] |= 0x20;}
				 }

				 if(cot<128){
					 mangxuatled1[hang][pwm][cot]=0;
					 if((manght[0][hang][cot] & pixel)) {mangxuatled1[hang][pwm][cot] |= 0x01;}
					 if((manght[0][hang+16][cot] & pixel)) {mangxuatled1[hang][pwm][cot] |= 0x02;}
					 if((manght[1][hang][cot] & pixel)) {mangxuatled1[hang][pwm][cot] |= 0x04;}
					 if((manght[1][hang+16][cot] & pixel)) {mangxuatled1[hang][pwm][cot] |= 0x08;}
					 if((manght[2][hang][cot] & pixel)) {mangxuatled1[hang][pwm][cot] |= 0x10;}
					 if((manght[2][hang+16][cot] & pixel)) {mangxuatled1[hang][pwm][cot] |= 0x20;}
				 }
				 else{
					 mangxuatled1[hang][pwm][cot]=0;
					 if((manght[0][63-hang][128-cot] & pixel)) {mangxuatled1[hang][pwm][cot] |= 0x01;}
					 if((manght[0][47-hang][128-cot] & pixel)) {mangxuatled1[hang][pwm][cot] |= 0x02;}
					 if((manght[1][63-hang][128-cot] & pixel)) {mangxuatled1[hang][pwm][cot] |= 0x04;}
					 if((manght[1][47-hang][128-cot] & pixel)) {mangxuatled1[hang][pwm][cot] |= 0x08;}
					 if((manght[2][63-hang][128-cot] & pixel)) {mangxuatled1[hang][pwm][cot] |= 0x10;}
					 if((manght[2][47-hang][128-cot] & pixel)) {mangxuatled1[hang][pwm][cot] |= 0x20;}
				 }
			 }
		 }
	}
}
union tinhieudk
{
	unsigned char bytedk;
  struct 
	{
		int  hang:4;
		int  tgian :3;
		int  chot:1;			
	}thanhphan;
} bytedieukhien;
unsigned char tgian=0,hangd=0;
void HAL_TIM_PeriodElapsedCallback(TIM_HandleTypeDef *htim){
	if(htim -> Instance == TIM1){
		 for(int __i=0;__i<256;__i++){
		  	GPIOD->ODR =  mangxuatled[bytedieukhien.thanhphan.hang][bytedieukhien.thanhphan.tgian][__i];
			 GPIOD->ODR |= 0x0040;
		
		 }
		 GPIOA -> ODR |= (1<<4);
		 TIM1->ARR = mangtg[bytedieukhien.thanhphan.tgian];
		 GPIOA -> ODR = bytedieukhien.thanhphan.hang;
		 bytedieukhien.bytedk++;
		 
	}
}
void  MATRIX_pixel_color(signed int x, signed int y,unsigned char r1,unsigned char g1,unsigned char b1){
	 if(x>127 || y>63) return;
	 if(x<0 || y<0) return;
		manght[0][y][x]=r1;
		manght[1][y][x]=g1;
		manght[2][y][x]=b1;
}
void MATRIX_clear_display(short y,short x,short w,short h){
	 short _y,_x;
	 w+=x;h+=y;
	 for(_y=y;_y<h;_y++)
		 for(_x=x;_x<w;_x++)
		 {
			MATRIX_pixel_color(_x,_y,0,0,0);
		 }
}
void MATRIX_line(signed int x1, signed int y1, signed int x2, signed int y2, unsigned char r,unsigned char g,unsigned char b)
{
   unsigned int        dy, dx;
   signed int  addx=1, addy=1;
   signed int P, diff;
	
   #ifdef LARGE_LCD
   unsigned int i=0;
   dx = abs((signed int)(x2 - x1));
   dy = abs((signed int)(y2 - y1));
   #else
   unsigned int  i=0;
   dx = abs((signed int)(x2 - x1));
   dy = abs((signed int)(y2 - y1));
   #endif
   if(x1 > x2)
      addx = -1;
   if(y1 > y2)
      addy = -1;
   if(dx >= dy)
   {
      dy *= 2;
      P = dy - dx;
      diff = P - dx;

      for(; i<=dx; ++i)
      {
    	  MATRIX_pixel_color(x1, y1, r,g,b);
         if(P < 0)
         {
            P  += dy;
            x1 += addx;
         }
         else
         {
            P  += diff;
            x1 += addx;
            y1 += addy;
         }
      }
   }
   else
   {
      dx *= 2;
      P = dx - dy;
      diff = P - dy;
      for(; i<=dy; ++i)
      {
    	  MATRIX_pixel_color(x1, y1, r,g,b);

         if(P < 0)
         {
            P  += dx;
            y1 += addy;
         }
         else
         {
            P  += diff;
            x1 += addx;
            y1 += addy;
         }
      }
   }
}
void MATRIX_circle(signed int x, signed int y, signed int radius, int fill,  unsigned char r1,unsigned char g1,unsigned char b1)
{
   signed int  a, b, P;
   a = 0;
   b = radius;
   P = 1 - radius;
   do
   {
      if(fill)
      {
    	  MATRIX_line(x-a, y+b, x+a, y+b,r1,g1,b1);
    	  MATRIX_line(x-a, y-b, x+a, y-b,r1,g1,b1);
    	  MATRIX_line(x-b, y+a, x+b, y+a,r1,g1,b1);
    	  MATRIX_line(x-b, y-a, x+b, y-a,r1,g1,b1);
      }
      else
      {
    	  MATRIX_pixel_color(a+x, b+y, r1,g1,b1);
    	  MATRIX_pixel_color(b+x, a+y, r1,g1,b1);
    	  MATRIX_pixel_color(x-a, b+y, r1,g1,b1);
    	  MATRIX_pixel_color(x-b, a+y, r1,g1,b1);
    	  MATRIX_pixel_color(b+x, y-a, r1,g1,b1);
    	  MATRIX_pixel_color(a+x, y-b, r1,g1,b1);
    	  MATRIX_pixel_color(x-a, y-b, r1,g1,b1);
    	  MATRIX_pixel_color(x-b, y-a, r1,g1,b1);
      }
      if(P < 0)
         P += 3 + 2 * a++;
      else
         P += 5 + 2 * (a++ - b--);
    } while(a <= b);
}
void MATRIX_rect(unsigned int x1, unsigned int y1, unsigned int x2, unsigned int y2, int fill, unsigned char r,unsigned char g,unsigned char b)
{
   if(fill)
   {
      #ifdef LARGE_LCD
      unsigned int i, xmin, xmax, ymin, ymax;
      #else
      unsigned int  i, xmin, xmax, ymin, ymax;
      #endif
      if(x1 < x2)                            //  Find x min and max
      {
         xmin = x1;
         xmax = x2;
      }
      else
      {
         xmin = x2;
         xmax = x1;
      }

      if(y1 < y2)                            // Find the y min and max
      {
         ymin = y1;
         ymax = y2;
      }
      else
      {
         ymin = y2;
         ymax = y1;
      }
      for(; xmin <= xmax; ++xmin)
      {
         for(i=ymin; i<=ymax; ++i)
         {
        	 MATRIX_pixel_color(xmin, i, r,g,b);
         }
      }
   }
   else
   {
      MATRIX_line(x1, y1, x2, y1, r,g,b);      // Draw the 4 sides
      MATRIX_line(x1, y2, x2, y2, r,g,b);
      MATRIX_line(x1, y1, x1, y2, r,g,b);
      MATRIX_line(x2, y1, x2, y2, r,g,b);
   }
}
void MATRIX_putchar16x32(signed char x,signed char y,unsigned char chu,unsigned char r,unsigned char g,unsigned char b){
	
	 for(int i=0;i<64;i=i+2)
		 for(int j=0;j<16;j++)
		 {
			 if(check_bit(myfont16x32[chu][i+j/8],(15-j)%8)){
				 MATRIX_pixel_color(y+j,x+i/2,r,g,b);
			 }
		}
}
void MATRIX_putStr16x32(signed char x,signed char y,unsigned char a[],unsigned char r,unsigned char g,unsigned char b){
	unsigned char i=0;
	while(a[i]!=0x00){
		 MATRIX_putchar16x32(x,y,a[i],r,g,b);
		 i++;
		 y=y+13;
	}
}


unsigned short hang_led,p10_x,p10_y;
char hieuung=0;

void P10_sendnumBIG(char num)
{
		for(int mau=0;mau<3;mau++)
			 for(int y=0;y<15;y++)
	       {
					 if(y+p10_y>127)break;
					 for(int x=0;x<10;x++)
							{
								if(x+p10_x>127)break;
							  manght[mau][y+p10_y][x+p10_x]=number_fx[hieuung][num][mau][y][x];				   
					    }
				 }
		p10_x+=11;
}
void P10_chonvitri(char y,char x)
{
	 p10_x=x;
	 p10_y=y;
}
void insoto(char y,char x,char so)
{
	
	P10_chonvitri(y,x);
	P10_sendnumBIG(so/10);
	P10_sendnumBIG(so%10);
}

void P10_sendnumSmall(char num)
{
		for(int mau=0;mau<3;mau++)
			 for(int y=0;y<8;y++)
					 for(int x=0;x<5;x++)
							 manght[mau][y+p10_y][x+p10_x]=number_nho_fx[hieuung][num][mau][y][x];
		p10_x+=6;
}
void insonho(char y,char x,char so)
{
	P10_chonvitri(y,x);
	P10_sendnumSmall(so/10);
	P10_sendnumSmall(so%10);
}
const uint8_t gamma8[] = {
    0,  0,  0,  0,  0,  0,  0,  0,  0,  0,  0,  0,  0,  0,  0,  0,
    0,  0,  0,  0,  0,  0,  0,  0,  0,  0,  0,  0,  1,  1,  1,  1,
    1,  1,  1,  1,  1,  1,  1,  1,  1,  2,  2,  2,  2,  2,  2,  2,
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  215,218,220,223,225,228,231,233,236,239,241,244,247,249,252,255 };

void giaimaanh1(unsigned char *anh,unsigned short dai,unsigned short rong,signed int x,signed int y)
{
	 unsigned short n,hang=0,cot=0;
	 for(n=0;n<(dai*rong*3);n+=3)
	 {   
					manght[0][x+hang][y+cot]=gamma8[anh[n+2]];
					manght[1][x+hang][y+cot]=gamma8[anh[n+1]];
					manght[2][x+hang][y+cot]=gamma8[anh[n]];
		    cot++;
		    if(cot==dai) {cot=0;hang++;}
	 }
}
void giaimaanh2(unsigned char *anh, unsigned int dai, unsigned int rong, signed int x, signed int y)
{
  unsigned short n,hang=0,cot=0;
   for(n=0;n<(dai*rong);n++)
   {   
				if(anh[n]==0x00&&anh[dai*rong+n]==0x00&&anh[2*dai*rong+n]==0x00){
					cot++;
					if(cot==dai) {cot=0;hang++;}
				}
				else{
						manght[0][x+hang][y+cot]=gamma8[anh[n]];
						manght[1][x+hang][y+cot]=gamma8[anh[dai*rong+n]];
						manght[2][x+hang][y+cot]=gamma8[anh[2*dai*rong+n]];
         cot++;
         if(cot==dai) {cot=0;hang++;}
			  }
   }
}
void giaimaanh3(unsigned char *anh, unsigned int dai, unsigned int rong, signed int x, signed int y)
{
  unsigned short n,hang=0,cot=0;
   for(n=0;n<(dai*rong);n++)
   {   
				if(anh[n]==0x00&&anh[dai*rong+n]==0x00&&anh[2*dai*rong+n]==0x00){
					cot++;
					if(cot==dai) {cot=0;hang++;}
				}
				else{
						manght[0][x+hang][y+cot]=anh[n]; 
						manght[1][x+hang][y+cot]=anh[dai*rong+n];
						manght[2][x+hang][y+cot]=anh[2*dai*rong+n];
         cot++;
         if(cot==dai) {cot=0;hang++;}
			  }
   }
}
void MATRIX_putchar16x16(unsigned char x,unsigned char y,unsigned char chu,unsigned char r,unsigned char g,unsigned char b){
	 for(int i=0;i<32;i=i+2)
		 for(int j=0;j<16;j++)
		 {
			 if(check_bit(font11[chu][i+j/8],(15-j)%8)){
					if(x+i/2 >127) return;
					if(y+j >127)  return;
					manght[0][x+i/2][y+j]=r;
					manght[1][x+i/2][y+j]=g;
					manght[2][x+i/2][y+j]=b;
			}		 
		}
}
void MATRIX_putStr16x16(signed int x,signed int y,unsigned char a[],unsigned char r,unsigned char g,unsigned char b){
	unsigned char i=0;
	while(a[i]!=0x00){
		 MATRIX_putchar16x16(x,y,a[i],r,g,b);
		 i++;
		 y=y+8;
	}
}
void MATRIX_circle1(signed int x, signed int y, signed int radius, int fill,  unsigned char r1,unsigned char g1,unsigned char b1)
{
	 int ran=255;
   signed int  a, b, P;
   a = 0;
   b = radius;
   P = 1 - radius;
   do
   {
		  ran+=100;
			srand(ran);
      if(fill)
      {
    	  MATRIX_line(x-a, y+b, x+a, y+b,r1,g1,b1);
    	  MATRIX_line(x-a, y-b, x+a, y-b,r1,g1,b1);
    	  MATRIX_line(x-b, y+a, x+b, y+a,r1,g1,b1);
    	  MATRIX_line(x-b, y-a, x+b, y-a,r1,g1,b1);
      }
      else
      {
    	  MATRIX_pixel_color(a+x, b+y, r1,g1,b1);
    	  MATRIX_pixel_color(b+x, a+y, r1,g1,b1);
    	  MATRIX_pixel_color(x-a, b+y, r1,g1,b1);
    	  MATRIX_pixel_color(x-b, a+y, r1,g1,b1);
    	  MATRIX_pixel_color(b+x, y-a, r1,g1,b1);
    	  MATRIX_pixel_color(a+x, y-b, r1,g1,b1);
    	  MATRIX_pixel_color(x-a, y-b, r1,g1,b1);
    	  MATRIX_pixel_color(x-b, y-a, r1,g1,b1);
      }
      if(P < 0){
				 a+=rand()%7;
         P += 2 + 2 * a;
			}
      else{
				 a+=5;
				 b-=5;
         P += 5 + 2 * (a - b);
			}
    } while(a <= b);
}

void drawPixelRGB565(int16_t x, int16_t y, uint16_t color) {
  uint8_t r = ((((color >> 11) & 0x1F) * 527) + 23) >> 6;
  uint8_t g = ((((color >> 5) & 0x3F) * 259) + 33) >> 6;
  uint8_t b = (((color & 0x1F) * 527) + 23) >> 6;
  MATRIX_pixel_color( x,  y, r, g,b);
}
void drawImage(int x, int y,int w,int h,uint16_t *a)
{
  int imageHeight = h;
  int imageWidth = w;
  int counter = 0;
  for (int yy = 0; yy < imageHeight; yy++)
  {
    for (int xx = 0; xx < imageWidth; xx++)
    {
      drawPixelRGB565(xx + x , yy + y, a[counter]);
      counter++;
    }
  }
}
void MATRIX_Ellipse(int16_t x0, int16_t y0, uint16_t radiusX, uint16_t radiusY, unsigned char r,unsigned char g,unsigned char b) {
    int16_t twoASquare = 2 * radiusX * radiusX;
    int16_t twoBSquare = 2 * radiusY * radiusY;
    
    int16_t x = radiusX;
    int16_t y = 0;
    int16_t changeX = radiusY * radiusY * (1 - (2 * radiusX));
    int16_t changeY = radiusX * radiusX;
    int16_t ellipseError = 0;
    int16_t stoppingX = twoBSquare * radiusX;
    int16_t stoppingY = 0;
    
    while (stoppingX >= stoppingY) {    // first set of points, y' > -1
        MATRIX_pixel_color(x0 + x, y0 + y, r,g,b);
        MATRIX_pixel_color(x0 - x, y0 + y, r,g,b);
        MATRIX_pixel_color(x0 - x, y0 - y, r,g,b);
        MATRIX_pixel_color(x0 + x, y0 - y, r,g,b);
        
        y++;
        stoppingY += twoASquare;
        ellipseError += changeY;
        changeY += twoASquare;
        
        if (((2 * ellipseError) + changeX) > 0) {
            x--;
            stoppingX -= twoBSquare;
            ellipseError += changeX;
            changeX += twoBSquare;
        }
    }
    
    // first point set is done, start the second set of points
    
    x = 0;
    y = radiusY;
    changeX = radiusY * radiusY;
    changeY = radiusX * radiusX * (1 - 2 * radiusY);
    ellipseError = 0;
    stoppingX = 0;
    stoppingY = twoASquare * radiusY;
    
    while (stoppingX <= stoppingY) {    // second set of points, y' < -1
        MATRIX_pixel_color(x0 + x, y0 + y, r,g,b);
        MATRIX_pixel_color(x0 - x, y0 + y, r,g,b);
        MATRIX_pixel_color(x0 - x, y0 - y, r,g,b);
        MATRIX_pixel_color(x0 + x, y0 - y, r,g,b);
        
        x++;
        stoppingX += twoBSquare;
        ellipseError += changeX;
        changeX += twoBSquare;
        
        if (((2 * ellipseError) + changeY) > 0) {
            y--;
            stoppingY -= twoASquare;
            ellipseError += changeY;
            changeY += twoASquare;
        }
    }
}
void Chord(int r, float rot)
{
  int nodes = 6;
  float x[nodes];
  float y[nodes];
  for (int i=0; i<nodes; i++)
  {
    float a = rot + (3.14*2*i/nodes);
    x[i] = 31+3 + cos(a)*r;
    y[i] = 16 + sin(a)*r;
  }

  for (int i=0; i<(nodes-1); i++)
    for (int j=i+1; j<nodes; j++)
      MATRIX_line(30+x[i],30+y[i], 30+x[j],30+y[j], 0,255,0);
}

void MATRIX_putchar16x16color(unsigned char x,unsigned char y,unsigned char chu,unsigned char hux,unsigned char huy){
	
	 for(int i=0;i<32;i=i+2)
		 for(int j=0,k=0;j<16;j++,k=k+10)
		 {
			 if(check_bit(font11[chu][i+j/8],(15-j)%8)){
					if(x+i/2 >127 || x+i/2<0 ) return;
					if(y+j >255 || y+j<0)  return;
					manght[0][x+i/2][y+j]=rd_map_chaychu[0][hux][huy+j];
					manght[1][x+i/2][y+j]=rd_map_chaychu[1][hux][huy+j];
					manght[2][x+i/2][y+j]=rd_map_chaychu[2][hux][huy+j];
			}		 
		}
}
void MATRIX_putStr16x16color(signed int x,signed int y,unsigned char a[],unsigned char hux,unsigned char huy){
	unsigned char i=0;
	while(a[i]!=0x00){
		 MATRIX_putchar16x16color(x,y,a[i],hux,huy);
		 i++;
		 y=y+8;
		 huy+=8;
	}
}

void MATRIX_line_color(signed int x1, signed int y1, signed int x2, signed int y2,signed int x3,signed int y3)
{
   unsigned int        dy, dx;
   signed int  addx=1, addy=1;
   signed int P, diff;
	
   #ifdef LARGE_LCD
   unsigned int i=0;
   dx = abs((signed int)(x2 - x1));
   dy = abs((signed int)(y2 - y1));
   #else
   unsigned int  i=0;
   dx = abs((signed int)(x2 - x1));
   dy = abs((signed int)(y2 - y1));
   #endif
   if(x1 > x2)
      addx = -1;
   if(y1 > y2)
      addy = -1;
   if(dx >= dy)
   {
      dy *= 2;
      P = dy - dx;
      diff = P - dx;

      for(; i<=dx; ++i)
      {
				manght[0][y1][x1]=rd_map_chaychu[0][y3][x3];
				manght[1][y1][x1]=rd_map_chaychu[1][y3][x3];
				manght[2][y1][x1]=rd_map_chaychu[2][y3][x3];
         if(P < 0)
         {
            P  += dy;
            x1 += addx;
         }
         else
         {
            P  += diff;
            x1 += addx;
            y1 += addy;
         }
      }
   }
   else
   {
      dx *= 2;
      P = dx - dy;
      diff = P - dy;
      for(; i<=dy; ++i)
      {
    	  manght[0][y1][x1]=rd_map_chaychu[0][y3][x3];
				manght[1][y1][x1]=rd_map_chaychu[1][y3][x3];
				manght[2][y1][x1]=rd_map_chaychu[2][y3][x3];
         if(P < 0)
         {
            P  += dx;
            y1 += addy;
         }
         else
         {
            P  += diff;
            x1 += addx;
            y1 += addy;
         }
      }
   }
}
void  MATRIX_pixel_color_update(unsigned int x, unsigned int y,signed int x1,unsigned int y1){
			manght[0][y][x]=rd_map_chaychu[0][y1][x1];
			manght[1][y][x]=rd_map_chaychu[1][y1][x1];
			manght[2][y][x]=rd_map_chaychu[2][y1][x1];
}

void MATRIX_circle_color(signed int x, signed int y, signed int radius, int fill,signed int maux,signed int mauy)
{
   signed int  a, b, P;
   a = 0;
   b = radius;
   P = 1 - radius;
   do
   {
      if(fill)
      {
    	  MATRIX_line_color(x-a, y+b, x+a, y+b,maux,mauy);
    	  MATRIX_line_color(x-a, y-b, x+a, y-b,maux,mauy);
    	  MATRIX_line_color(x-b, y+a, x+b, y+a,maux,mauy);
    	  MATRIX_line_color(x-b, y-a, x+b, y-a,maux,mauy);
      }
      else
      {
    	  MATRIX_pixel_color_update(a+x, b+y,a+maux,b+mauy);
    	  MATRIX_pixel_color_update(b+x, a+y,b+maux,a+mauy);
    	  MATRIX_pixel_color_update(x-a, b+y,maux-a,b+mauy);
    	  MATRIX_pixel_color_update(x-b, a+y,maux-b,a+mauy);
    	  MATRIX_pixel_color_update(b+x, y-a,b+maux,mauy-a);
    	  MATRIX_pixel_color_update(a+x, y-b,a+maux,mauy-b);
    	  MATRIX_pixel_color_update(x-a, y-b,maux-a,mauy-b);
    	  MATRIX_pixel_color_update(x-b, y-a,maux-b,mauy-a);
      }
      if(P < 0)
         P += 3 + 2 * a++;
      else
         P += 5 + 2 * (a++ - b--);
    } while(a <= b);
}
void MATRIX_triangle(signed int x0, signed int y0,signed int x1, signed int y1, signed int x2, signed int y2,unsigned char r1,unsigned char g1,unsigned char b1) {
  MATRIX_line(x0, y0, x1, y1, r1,g1,b1);
  MATRIX_line(x1, y1, x2, y2, r1,g1,b1);
  MATRIX_line(x2, y2, x0, y0, r1,g1,b1);
}
void drawFastHLine(signed int x, signed int y, 
				 signed int w, unsigned char r,unsigned char g,unsigned char b) {
  // stupidest version - update in subclasses if desired!
  MATRIX_line(x, y, x+w-1, y, r,g,b);
}
void swap(signed int *a,signed *b){
		signed int tam;
		tam=*a;
		*a=*b;
		*b=tam;
}
void MATRIX_fillTriangle (signed int x0, signed int y0,signed int x1, signed int y1, signed int x2, signed int y2,unsigned char r1,unsigned char g1,unsigned char b1) {

  signed int a, b, y, last;

  // Sort coordinates by Y order (y2 >= y1 >= y0)
	if (y0 > y1) {
    swap(&y0, &y1); swap(&x0, &x1);
  }
  if (y1 > y2) {
    swap(&y2, &y1); swap(&x2, &x1);
  }
  if (y0 > y1) {
    swap(&y0, &y1); swap(&x0, &x1);
  }
  if(y0 == y2) { // Handle awkward all-on-same-line case as its own thing
    a = b = x0;
    if(x1 < a)      a = x1;
    else if(x1 > b) b = x1;
    if(x2 < a)      a = x2;
    else if(x2 > b) b = x2;
    drawFastHLine(a, y0, b-a+1,r1,g1,b1);
    return;
  }

  int16_t
    dx01 = x1 - x0,
    dy01 = y1 - y0,
    dx02 = x2 - x0,
    dy02 = y2 - y0,
    dx12 = x2 - x1,
    dy12 = y2 - y1,
    sa   = 0,
    sb   = 0;

  // For upper part of triangle, find scanline crossings for segments
  // 0-1 and 0-2.  If y1=y2 (flat-bottomed triangle), the scanline y1
  // is included here (and second loop will be skipped, avoiding a /0
  // error there), otherwise scanline y1 is skipped here and handled
  // in the second loop...which also avoids a /0 error here if y0=y1
  // (flat-topped triangle).
  if(y1 == y2) last = y1;   // Include y1 scanline
  else         last = y1-1; // Skip it

  for(y=y0; y<=last; y++) {
    a   = x0 + sa / dy01;
    b   = x0 + sb / dy02;
    sa += dx01;
    sb += dx02;
    /* longhand:
    a = x0 + (x1 - x0) * (y - y0) / (y1 - y0);
    b = x0 + (x2 - x0) * (y - y0) / (y2 - y0);
    */
		if(a > b) swap(&a,&b);
    drawFastHLine(a, y, b-a+1, r1,g1,b1);
  }

  // For lower part of triangle, find scanline crossings for segments
  // 0-2 and 1-2.  This loop is skipped if y1=y2.
  sa = dx12 * (y - y1);
  sb = dx02 * (y - y0);
  for(; y<=y2; y++) {
    a   = x1 + sa / dy12;
    b   = x0 + sb / dy02;
    sa += dx12;
    sb += dx02;
    /* longhand:
    a = x1 + (x2 - x1) * (y - y1) / (y2 - y1);
    b = x0 + (x2 - x0) * (y - y0) / (y2 - y0);
    */
		 if(a > b) swap(&a,&b);
    drawFastHLine(a, y, b-a+1, r1,g1,b1);
  }
}




//64x32
const uint16_t  mario[] = {
  0x07FF, 0x07FF, 0x07FF, 0x07FF, 0x07FF, 0x07FF, 0x07FF, 0x07FF, 0x07FF, 0x07FF, 0x07FF, 0x07FF, 0x07FF, 0x07FF, 0x07FF, 0x07FF,   // 0x0010 (16) pixels
  0x07FF, 0x07FF, 0x07FF, 0x07FF, 0x07FF, 0x07FF, 0x07FF, 0x07FF, 0x07FF, 0x07FF, 0x07FF, 0x07FF, 0x07FF, 0x07FF, 0x07FF, 0x07FF,   // 0x0020 (32) pixels
  0x07FF, 0x07FF, 0x07FF, 0x07FF, 0x07FF, 0x07FF, 0x07FF, 0x07FF, 0x07FF, 0x07FF, 0x07FF, 0x07FF, 0x07FF, 0x07FF, 0x07FF, 0x07FF,   // 0x0030 (48) pixels
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  0x4FE0, 0x4FE0, 0x4FE0, 0x4FE0, 0x4FE0, 0x4FE0, 0x4FE0, 0x4FE0, 0x4FE0, 0x4FE0, 0x4FE0, 0x4FE0, 0x4FE0, 0x4FE0, 0x4FE0, 0x4FE0,   // 0x0800 (2048) pixels
};
//32x32
const  uint16_t image[] = {
0x0000, 0x0000, 0x0000, 0x0000, 0x0000, 0x0000, 0x0000, 0x0000, 0x0000, 0x0000, 0x0021, 0x096B, 0x1292, 0x1358, 0x1BDC, 0x1C3E,   // 0x0010 (16) pixels
0x1C3E, 0x1BDC, 0x1358, 0x1292, 0x096B, 0x0021, 0x0000, 0x0000, 0x0000, 0x0000, 0x0000, 0x0000, 0x0000, 0x0000, 0x0000, 0x0000,   // 0x0020 (32) pixels
0x0000, 0x0000, 0x0000, 0x0000, 0x0000, 0x0000, 0x0000, 0x0000, 0x0084, 0x1292, 0x1BFD, 0x1C3E, 0x1C3E, 0x1C3E, 0x1C3E, 0x1C3E,   // 0x0030 (48) pixels
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0x1C3E, 0x1BDC, 0x1359, 0x1293, 0x096B, 0x0042, 0x0000, 0x0000, 0x0000, 0x0000, 0x0000, 0x0000, 0x0000, 0x0000, 0x0000, 0x0000,   // 0x0400 (1024) pixels
};
#endif